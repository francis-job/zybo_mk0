## configs/zybo_defconfig
```kconfig
BR2_arm=y
BR2_cortex_a9=y
BR2_ARM_ENABLE_NEON=y
BR2_ARM_ENABLE_VFP=y
BR2_TOOLCHAIN_BUILDROOT_GLIBC=y
BR2_PACKAGE_HOST_LINUX_HEADERS_CUSTOM_5_11=y
BR2_TOOLCHAIN_BUILDROOT_CXX=y
BR2_TARGET_GENERIC_HOSTNAME="JARVIS"
BR2_TARGET_GENERIC_ISSUE="Welcome Mr. FRANCIS"
BR2_INIT_SYSTEMD=y
BR2_SYSTEM_BIN_SH_BASH=y
BR2_TARGET_GENERIC_GETTY_PORT="ttyPS0"
BR2_SYSTEM_DHCP="eth0"
BR2_SYSTEM_DEFAULT_PATH="/bin:/sbin:/usr/bin:/usr/sbin"
#uncomment the following line if apache webserver is enabled
#BR2_ROOTFS_OVERLAY="$(BR2_EXTERNAL_ZYBO_PATH)/rootfs_overlay/"
BR2_ROOTFS_POST_IMAGE_SCRIPT="$(BR2_EXTERNAL_ZYBO_PATH)/board/zybo/post-image.sh"
BR2_LINUX_KERNEL=y
BR2_LINUX_KERNEL_CUSTOM_VERSION=y
BR2_LINUX_KERNEL_CUSTOM_VERSION_VALUE="5.11"
BR2_LINUX_KERNEL_DEFCONFIG="multi_v7"
BR2_LINUX_KERNEL_UIMAGE=y
BR2_LINUX_KERNEL_UIMAGE_LOADADDR="0x8000"
BR2_LINUX_KERNEL_DTS_SUPPORT=y
BR2_LINUX_KERNEL_INTREE_DTS_NAME="zynq-zybo"
BR2_PACKAGE_APR_UTIL=y
BR2_PACKAGE_PCRE=y
BR2_TARGET_ROOTFS_CPIO=y
BR2_TARGET_ROOTFS_CPIO_GZIP=y
BR2_TARGET_ROOTFS_CPIO_UIMAGE=y
BR2_TARGET_ROOTFS_EXT2=y
BR2_TARGET_ROOTFS_EXT2_4=y
BR2_TARGET_ROOTFS_EXT2_SIZE="90M"
BR2_TARGET_UBOOT=y
BR2_TARGET_UBOOT_BUILD_SYSTEM_KCONFIG=y
BR2_TARGET_UBOOT_CUSTOM_GIT=y
BR2_TARGET_UBOOT_CUSTOM_REPO_URL="https://github.com/Xilinx/u-boot-xlnx"
BR2_TARGET_UBOOT_CUSTOM_REPO_VERSION="xilinx-v2018.3"
BR2_TARGET_UBOOT_BOARD_DEFCONFIG="zynq_zybo"
BR2_TARGET_UBOOT_NEEDS_DTC=y
BR2_TARGET_UBOOT_NEEDS_OPENSSL=y
BR2_TARGET_UBOOT_FORMAT_IMG=y
BR2_TARGET_UBOOT_SPL=y
BR2_TARGET_UBOOT_SPL_NAME="spl/boot.bin"
BR2_PACKAGE_HOST_DOSFSTOOLS=y
BR2_PACKAGE_HOST_GENIMAGE=y
BR2_PACKAGE_HOST_MTOOLS=y
```

## packages/Config.in
```kconfig
menu "External Packages"

menu "Userspace Packages" 
	source "$BR2_EXTERNAL_ZYBO_PATH/packages/hello_francis/Config.in"
endmenu

menu "Kernel Modules"
	source "$BR2_EXTERNAL_ZYBO_PATH/packages/kernel_test_module/Config.in"
endmenu

menu "Web server App"
	source "$BR2_EXTERNAL_ZYBO_PATH/packages/apache2/Config.in"
endmenu

endmenu
```

## packages/apache2/Config.in
```kconfig
config BR2_PACKAGE_APACHE2
	bool "apache2"
	depends on !BR2_STATIC_LIBS
	depends on BR2_TOOLCHAIN_HAS_THREADS
	depends on BR2_USE_MMU
	select BR2_PACKAGE_APR_UTIL
	select BR2_PACKAGE_PCRE
	help
	  Apache web server package for testing

if BR2_PACKAGE_APACHE2

#BR2_ROOTFS_OVERLAY = "$(BR2_EXTERNAL_ZYBO_PATH)/rootfs_overlay"

config BR2_PACKAGE_APACHE2_MPM_WORKER
        bool "worker"
	default y
        help
          Implements a hybrid multi-threaded multi-process web server


endif


comment "apache needs a toolchain w/ dynamic library, threads"
        depends on BR2_USE_MMU
        depends on BR2_STATIC_LIBS || !BR2_TOOLCHAIN_HAS_THREADS
```

## packages/hello_francis/Config.in
```kconfig
config BR2_PACKAGE_HELLO_FRANCIS
    bool "hello_francis"
    help
        Hello francis package.

        http://example.com
```

## packages/kernel_test_module/Config.in
```kconfig
config BR2_PACKAGE_KERNEL_TEST_MODULE
	bool "kernel_test_module"
	help
		kernel test module for buildroot integration.

		http://example.com
```
